## config/config.in
```kconfig
config LVGL 
    bool "Enable lvgl" 
    default n 
help 
    This is lvgl support.

menu "lvgl option"
	depends on LVGL

	source "../services/microPython/config/lvgl_option.in"
	endmenu 

config QRCODE 
    bool "Enable qrcode" 
    default n 
help 
    This is qrcode support.



config CAMERA 
    bool "Enable camera" 
    default n 
help 
    This is camera support.

config CAMERA_DECODE
    bool "Enable camera decoding function"
    depends on CAMERA
    default n
help 
    This is the camera scan decoding function.

config CAMERA_SAVEPHOTOS
    bool "Enable Save photo function"
    depends on CAMERA
    default n
help 
    Realize the function of saving photos.


config QUECTHING 
    bool "Enable quecthing" 
    default y 
help 
    This is quecIot support.

config SPINAND 
    bool "Enable spi nand flash" 
    default n
help 
    This is SPINANDFLASH support.

choice SPINAND_FILESYSTEM
   bool "Select nandflash file system"
   default NANDFLASH_YAFFS2
   depends on SPINAND
   help
       Select nandflash file system.

config NANDFLASH_YAFFS2
   bool "yaffs2 file system"
config NANDFLASH_FAT
   bool "fat file system"
endchoice

config RTMP 
    bool "Enable rtmp" 
    default n
help 
    This is rtmp support.

config JPEG
    bool "Enable jpeg" 
    default n
help 
    Support JPEG and RGB conversion.

config SPI_SDCARD
    bool "Enable SPI SD Card" 
    default n
help 
    Support SPI SD Card support.

config BT
    bool "Enable BT OR BLE" 
    default n
help 
    This is BT support.
	
config VIOCE_CALL
    bool "Enable VoiceCall" 
    default n
help 
    This is VoiceCall support.

config TTS
    bool "Enable TTS" 
    default n
help 
    This is TTS support.
```
